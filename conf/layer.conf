## conf/layer.conf
```bitbake
BBPATH := "${BBPATH}:${LAYERDIR}"

BBFILES += "${LAYERDIR}/recipes-*/*/*.bb"
BBFILES += "${LAYERDIR}/recipes-*/*/*.bbappend"

BBFILES_DYNAMIC += " \
    clang-layer:${LAYERDIR}/dynamic-layers/clang-layer/*/*/*.bb \
    clang-layer:${LAYERDIR}/dynamic-layers/clang-layer/*/*/*.bbappend \
"

BBFILE_COLLECTIONS += "scikit-learn"
BBFILE_PATTERN_scikit-learn := "^${LAYERDIR}/"
BBFILE_PRIORITY_scikit-learn = "5"

LAYERDEPENDS_scikit-learn = "openembedded-layer meta-python meta-scipy"
LAYERSERIES_COMPAT_scikit-learn = "gatesgarth hardknott honister kirkstone langdale mickledore nanbield"
```
